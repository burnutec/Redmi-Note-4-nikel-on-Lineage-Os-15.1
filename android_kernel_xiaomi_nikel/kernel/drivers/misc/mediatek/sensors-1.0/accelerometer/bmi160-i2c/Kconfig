## android_kernel_xiaomi_nikel/kernel/drivers/misc/mediatek/sensors-1.0/accelerometer/bmi160-i2c/Kconfig
```kconfig
config MTK_BMI160_I2C
	bool "BMI160 accelerometer on I2C (nikel)"
	default n
	help
	  Bosch BMI160 accelerometer connected over I2C, as on the
	  Redmi Note 4 MTK (nikel). Converted from MTK_BMI160_SPI.
```

## android_kernel_xiaomi_nikel/kernel/drivers/misc/mediatek/sensors-1.0/gyroscope/bmi160gy-i2c/Kconfig
```kconfig
config MTK_BMI160GY_I2C
	bool "BMI160 gyroscope on I2C (nikel)"
	depends on MTK_BMI160_I2C
	default n
	help
	  Gyroscope part of the Bosch BMI160 on I2C (nikel). Uses the
	  register access of MTK_BMI160_I2C.
```

## android_kernel_xiaomi_nikel/kernel/drivers/misc/mediatek/sensors-1.0/magnetometer/yas537/Kconfig
```kconfig
config MTK_YAS537
	bool "Yamaha YAS537 magnetometer (nikel)"
	depends on CUSTOM_KERNEL_MAGNETOMETER
	default n
	help
	  Yamaha YAS537 (MS-3T) compass on I2C, as used on the
	  Redmi Note 4 MTK (nikel). Polled by the MediaTek mag
	  framework, with a simple hard-iron calibration in the driver.
```

## android_kernel_xiaomi_nikel/kernel/kernel/drivers/misc/mediatek/sensors-1.0/alsps/ltr579/Kconfig
```kconfig
config MTK_LTR579
	bool "LTR-579 ambient light / proximity sensor (nikel)"
	depends on CUSTOM_KERNEL_ALSPS
	default n
	help
	  Lite-On LTR-579ALS-01 light and proximity sensor on I2C,
	  as used on the Redmi Note 4 MTK (nikel). Both sensors are
	  polled by the MediaTek alsps framework.
```
